## package/python-opuslib/Config.in
```kconfig
config BR2_PACKAGE_PYTHON_OPUSLIB
	bool "python-opuslib"
	depends on BR2_PACKAGE_OPUS
	help
	  Python bindings to the libopus, IETF low-delay audio codec.

	  https://github.com/onbeep/opuslib
```

## package/python-pymumble/Config.in
```kconfig
config BR2_PACKAGE_PYTHON_PYMUMBLE
	bool "python-pymumble"
	select BR2_PACKAGE_PYTHON_OPUSLIB # runtime
	select BR2_PACKAGE_PYTHON_PROTOBUF # runtime
	help
	  Mumble library used for multiple uses like making mumble
	  bot.

	  https://github.com/azlux/pymumble
```

## package/python-pysdl2/Config.in
```kconfig
config BR2_PACKAGE_PYTHON_PYSDL2
	bool "python-pysdl2"
	depends on BR2_PACKAGE_SDL2 
	help
	  Python SDL2 bindings.

	  https://github.com/marcusva/py-sdl2
```
